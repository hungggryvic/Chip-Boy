#include "LocationApp.h"
#include <Adafruit_SSD1306.h>

// ============================================================================
// LOCATION APP IMPLEMENTATION
// ============================================================================

// Globals from main
extern bool inMenu;
extern bool uiDirty;
extern uint8_t lastSecondDrawn;
extern unsigned long menuEnableButtonsAt;
extern bool screenEnabled;
extern bool displayReady;
extern Adafruit_SSD1306 display;

extern int year, month, day, hour, minute, second;
extern unsigned long lastTickMs;

void normalizeDateTime();
void redrawMenuNow();

struct BtnState;
extern BtnState b1, b3;
bool btnWasShortPressed(const BtnState &b_in);
inline void buzzerStartLow();

// World map bitmap (128x64)
const unsigned char epd_bitmap_6859d67ca9ff5c24497a5dd3_2036643898_7314_4 [] PROGMEM = {
  0x00, 0x00, 0x00, 0x00, 0x00, 0x00, 0x00, 0x00, 0x00, 0x00, 0x00, 0x00, 0x00, 0x00, 0x00, 0x00,
  0x00, 0x00, 0x00, 0x00, 0x00, 0x00, 0x00, 0x00, 0x00, 0x00, 0x00, 0x00, 0x00, 0x00, 0x00, 0x00,
  0x00, 0x00, 0x00, 0x00, 0x00, 0x00, 0x00, 0x00, 0x00, 0x00, 0x00, 0x00, 0x00, 0x00, 0x00, 0x00,
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  0x00, 0x00, 0x00, 0x00, 0x00, 0x00, 0x00, 0x00, 0x00, 0x00, 0x00, 0x00, 0x00, 0x00, 0x00, 0x00
};

// ── Module globals ────────────────────────────────────────────────────────

bool inLocation = false;
bool gpsBootTimeSet = false;

const int GPS_RX_PIN = D5;
const int GPS_TX_PIN = D4;
const uint32_t GPS_BAUD = 9600;

TinyGPSPlus gps;
HardwareSerial &GPSSerial = Serial2;

static bool locationMapMode = false;
static uint32_t gpsLastDrawMs = 0;
static const int MAP_Y_OFFSET = 8;

// ── Helpers ───────────────────────────────────────────────────────────────

static void normalizeDateTimeSigned() {
  while (second < 0) { second += 60; minute--; }
  while (second >= 60) { second -= 60; minute++; }
  while (minute < 0) { minute += 60; hour--; }
  while (minute >= 60) { minute -= 60; hour++; }
  while (hour < 0) { hour += 24; day--; }
  while (hour >= 24) { hour -= 24; day++; }
  normalizeDateTime();
}

int getPacificOffsetMin(int y, int mon, int d, int h) {
  auto dowOf = [](int yr, int mo, int dy) -> int {
    if (mo < 3) { mo += 12; yr--; }
    int k = yr % 100, j = yr / 100;
    return (dy + (13*(mo+1)/5) + k + k/4 + j/4 + 5*j) % 7;
  };
  int dow1Mar = dowOf(y, 3, 1);
  int firstSunMar = (dow1Mar == 1) ? 1 : 1 + (8 - dow1Mar) % 7;
  int dstStart = firstSunMar + 7;
  int dow1Nov = dowOf(y, 11, 1);
  int dstEnd = (dow1Nov == 1) ? 1 : 1 + (8 - dow1Nov) % 7;
  bool isDST = false;
  if (mon > 3 && mon < 11) isDST = true;
  else if (mon == 3) isDST = (d > dstStart) || (d == dstStart && h >= 2);
  else if (mon == 11) isDST = (d < dstEnd) || (d == dstEnd && h < 2);
  return isDST ? -420 : -480;
}

bool gpsSyncClockOnBoot(uint32_t timeoutMs) {
  if (gpsBootTimeSet) return true;
  gps = TinyGPSPlus();
  GPSSerial.begin(GPS_BAUD, SERIAL_8N1, GPS_RX_PIN, GPS_TX_PIN);
  uint32_t start = millis();
  while (millis() - start < timeoutMs) {
    while (GPSSerial.available()) gps.encode(GPSSerial.read());
    if (gps.date.isValid() && gps.time.isValid() && gps.date.year() >= 2020) {
      year   = (int)gps.date.year();
      month  = (int)gps.date.month();
      day    = (int)gps.date.day();
      hour   = (int)gps.time.hour();
      minute = (int)gps.time.minute();
      second = (int)gps.time.second();
      int tzOffset = getPacificOffsetMin(year, month, day, hour);
      minute += tzOffset;
      normalizeDateTimeSigned();
      lastTickMs = millis();
      gpsBootTimeSet = true;
      uiDirty = true;
      lastSecondDrawn = 255;
      GPSSerial.end();
      return true;
    }
    delay(5);
    yield();
  }
  GPSSerial.end();
  return false;
}

// ── Map helpers ───────────────────────────────────────────────────────────

static inline int clampi(int v, int lo, int hi) {
  if (v < lo) return lo;
  if (v > hi) return hi;
  return v;
}

static void latLonToXY(double lat, double lon, int &x, int &y) {
  while (lon < -180.0) lon += 360.0;
  while (lon >= 180.0) lon -= 360.0;
  double xf = (lon + 180.0) * (127.0 / 360.0);
  double yf = (90.0 - lat)  * (63.0 / 180.0);
  x = clampi((int)(xf + 0.5), 0, 127);
  int yy = (int)(yf + 0.5) + MAP_Y_OFFSET;
  y = clampi(yy, 0, 63);
}

static void drawCrosshairCircle(int x, int y, int r, uint16_t color) {
  display.drawCircle(x, y, r, color);
  int x0 = clampi(x - (r + 2), 0, 127);
  int x1 = clampi(x + (r + 2), 0, 127);
  int y0 = clampi(y - (r + 2), 0, 63);
  int y1 = clampi(y + (r + 2), 0, 63);
  display.drawLine(x0, y, x1, y, color);
  display.drawLine(x, y0, x, y1, color);
  display.drawPixel(x, y, color);
}

// ── Draw functions ────────────────────────────────────────────────────────

static void drawLocationDataView() {
  display.clearDisplay();
  display.setTextColor(SSD1306_WHITE);
  display.setTextSize(1);

  display.setCursor(0, 0);
  display.println("ATGM336H GPS");

  display.setCursor(0, 12);
  display.print("Sats: ");
  if (gps.satellites.isValid()) display.print(gps.satellites.value());
  else display.print("--");

  display.setCursor(0, 22);
  display.print("Fix: ");
  display.print(gps.location.isValid() ? "YES" : "NO");

  if (gps.location.isValid()) {
    display.setCursor(0, 34);
    display.print("Lat:");
    display.setCursor(24, 34);
    display.print(gps.location.lat(), 6);
    display.setCursor(0, 46);
    display.print("Lon:");
    display.setCursor(24, 46);
    display.print(gps.location.lng(), 6);
  } else {
    display.setCursor(0, 40);
    display.print("Waiting for GPS.");
  }

  display.setCursor(0, 55);
  display.print("MAP");
  display.setCursor(104, 55);
  display.print("EXIT");
  display.display();
}

static void drawLocationMapView() {
  display.clearDisplay();
  display.drawBitmap(0, 0,
    epd_bitmap_6859d67ca9ff5c24497a5dd3_2036643898_7314_4,
    128, 64, SSD1306_WHITE);

  if (gps.location.isValid()) {
    int px, py;
    latLonToXY(gps.location.lat(), gps.location.lng(), px, py);
    drawCrosshairCircle(px, py, 4, SSD1306_INVERSE);
  }

  display.setTextSize(1);
  display.setTextColor(SSD1306_WHITE);
  display.setCursor(0, 55);
  display.print("DATA");
  display.setCursor(104, 55);
  display.print("EXIT");
  display.display();
}

// ── App lifecycle ─────────────────────────────────────────────────────────

void locationEnter() {
  inMenu = false;
  inLocation = true;
  uiDirty = true;
  gpsLastDrawMs = 0;
  locationMapMode = false;
  gps = TinyGPSPlus();
  GPSSerial.begin(GPS_BAUD, SERIAL_8N1, GPS_RX_PIN, GPS_TX_PIN);
}

void locationExit() {
  GPSSerial.end();
  inLocation = false;
  inMenu = true;
  uiDirty = true;
  lastSecondDrawn = 255;
  menuEnableButtonsAt = millis() + 120;
  redrawMenuNow();
}

void handleLocation() {
  if (btnWasShortPressed(b3)) { locationExit(); return; }

  if (btnWasShortPressed(b1)) {
    locationMapMode = !locationMapMode;
    uiDirty = true;
  }

  while (GPSSerial.available()) gps.encode(GPSSerial.read());

  uint32_t now = millis();
  if (!uiDirty && (now - gpsLastDrawMs) < 200) return;
  gpsLastDrawMs = now;
  uiDirty = false;

  if (!screenEnabled || !displayReady) return;

  if (locationMapMode) drawLocationMapView();
  else                drawLocationDataView();
}